## 2628.9_189/stblinux-2.6.28/arch/mips/brcmstb/Kconfig
```kconfig
# Broadcom STB Specific options

config MIPS_BRCM76XX
	bool ## "Broadcom 76xx series"
	select MIPS_BRCM97XXX
	select CPU_MIPS32_R2
	select MIPS_BCM_NDVD
	select HW_HAS_PCI
	select SYS_HAS_CPU_MIPS32_R2
	select SYS_SUPPORTS_32BIT_KERNEL
	select SYS_SUPPORTS_BIG_ENDIAN
	select SYS_SUPPORTS_LITTLE_ENDIAN
	select CEVT_R4K
	select CSRC_R4K
	select DMA_NONCOHERENT
	select ARCH_SELECT_MEMORY_MODEL
	select ARCH_SPARSEMEM_ENABLE
	# select SPARSEMEM_VMEMMAP_ENABLE
	# select ARCH_DISCONTIGMEM_ENABLE
	select CPU_SUPPORTS_HIGHMEM
	select SYS_SUPPORTS_HIGHMEM
	select NO_EXCEPT_FILL
	select USB_ARCH_HAS_HCD
	select USB_ARCH_HAS_EHCI
	select USB_ARCH_HAS_OHCI
	select SYS_HAS_SHARF
	select SYS_SUPPORTS_NDVD_PWR_MGMT if !MIPS_BCM7440


config MIPS_BRCM97XXX
	bool ## "Broadcom MIPS super chips BCM97xxx"
	#depends MIPS32
	select CPU_MIPS32_R1
	select SERIAL
	select DMA_NONCOHERENT
	select IRQ_CPU
	select MIPS_BRCM
	# Only swap on 32 bit.
	# select SWAP_IO_SPACE_L
	select SYS_SUPPORTS_32BIT_KERNEL
	select SYS_SUPPORTS_BIG_ENDIAN
	select SYS_SUPPORTS_LITTLE_ENDIAN
	select SYS_HAS_INTERNAL_BCM7038
	
config BRCM_AR_CHECKER_V1
	bool "Address range checker"
	depends on SYS_HAS_AR_CHECKER_V1
	help
	  Address range checker module version 1
	  Broadcom 7440B0

config BRCM_AR_CHECKER_V2
	bool "Address range checker"
	depends on SYS_HAS_AR_CHECKER_V2
	help
	  Address range checker module version 2
	  Broadcom 7601 7635

config NDVD_PWR_MGMT
	bool "Broadcom NDVD power management"
	depends on SYS_SUPPORTS_NDVD_PWR_MGMT

config SYNC_PRINTK_HACK
	bool "sync printk hack"
	default n
	help
	  Printks will bypass normal console print system and 
	  go directly to the console uart

# Broadcom options
config MIPS_BRCM
	bool

config MIPS_BCM_NDVD
	bool


config SERIAL
	bool

config SYS_HAS_AR_CHECKER_V1
	bool

config SYS_HAS_AR_CHECKER_V2
	bool

config SYS_HAS_VIDE_OFE
	bool

config SYS_HAS_INTERNAL_BCM7038
	bool

config SYS_HAS_BRCMNAND_VERSION_2
	bool

config SYS_HAS_BRCMNAND_VERSION_6
	bool

config SYS_HAS_BRCMNAND_VERSION_8
	bool

config SYS_HAS_SHARF
	bool

config SYS_HAS_SHARF_V1
	bool

config SYS_HAS_SHARF_V2
	bool

config SYS_HAS_SATA
	bool

config SYS_HAS_SDIO
	bool

config SYS_SUPPORTS_NDVD_PWR_MGMT
        bool

config  MIPS_BCM7440
	bool
	depends on MIPS_BCM7440B0

# end Broadcom
```

## 2628.9_189/stblinux-2.6.28/arch/mips/brcmstb/Kconfig.debug
```kconfig
config	HW_EMULATOR
	bool	"running on HW emulator"
	depends on BOOT_RAW
	help
	  Use this option if running on hardware emulator.
	  This may turn on additional debugging.

config	HW_EMULATOR_UART_DIVISOR
	int "UART divisor, non-zero"
	range 1 65535
	default "1"
	depends on HW_EMULATOR
	help
		This jams the UART divisor register with the configured value.
		This allows non-standard baud rates to be used.  
		It also overrides setting the baud rate in the 8250 driver.

		The default is 1, which results in a baud rate of 5062500
		for the 76xx SoC family
```

## 2628.9_189/stblinux-2.6.28/drivers/mtd/brcmnand/Kconfig
```kconfig
#
# linux/drivers/mtd/brcmnand/Kconfig
#

menu "Broadcom NAND Flash Device Drivers"
	depends on MTD != n

config MTD_BRCMNAND
	tristate "Broadcom NAND Device Support"
	default y
	depends on MTD
#   select LONG_LONG_SUPPORT if MTD_BRCMNAND_VERSION >= 2
	help
	  This enables support for accessing selected types of NAND flash
	  devices through the Broadcom NAND controller.

config MTD_BRCMNAND_VERIFY_WRITE
	bool "Verify Broadcom NAND page writes"
	default y
	depends on MTD_BRCMNAND
	help
	  This adds an extra check when data is written to the flash. The
	  Broadcom NAND flash device internally checks only bits transitioning
	  from 1 to 0. There is a rare possibility that even though the
	  device thinks the write was successful, a bit could have been
	  flipped accidentaly due to device wear or something else.

config MTD_BRCMNAND_EDU_POLL
	bool "Use polling with EDU"
	default n
	depends on MTD_BRCMNAND
	help
	   Use Tasklet with EDU_ISR

config MTD_BRCMNAND_EDU_INTR
	bool "Enable Broadcom EDU ISR"
	default n
	depends on MTD_BRCMNAND
	help
	   Use Interrupt Service Routine instead of polling mode

config MTD_BRCMNAND_EDU_TASKLET
	bool "Enable Broadcom Tasklet with EDU ISR"
	default y
	depends on MTD_BRCMNAND
	help
	   Use Tasklet with EDU Interrupt Service Routine instead of polling mode


config MTD_BRCMNAND_VERSION
	int "Broadcom Controller version number: 0 = v0.0, 1 = v0.1, 2 = v1.0"
	range 1  10
	depends on MTD_BRCMNAND
	default "2" if SYS_HAS_BRCMNAND_VERSION_2
	default "6" if SYS_HAS_BRCMNAND_VERSION_6
	default "8" if SYS_HAS_BRCMNAND_VERSION_8
	default 1
	help
		Version number of the controller.
		Value	Maj.Min Platform
			0		0.0			7400A0
		1	0.1	7401Cx, 7400B0, 7118A0, 7403 * 7451, 7452, 3563
		2	1.0	7440B0, 7405a0 (also 7118C0 running as 1.0 in 2.6.12)
		3	2.0	7325
		4	2.1	7335
		5	2.2	7118C0 & 7405b0 (in 2.6.18) /* Not implemented for 2.6.12 */ 
		6	3.0	3548a0 (in 2.6.18), 7601a0 & 7601b0 (in 2.6.18, 2.6.24)
		7	3.2	Device ID decode update, 7413b0
		8	3.3	Expand ACC/CONFIG to allow per chip registers, 7420b0, 7635a0

endmenu
```
